## conf/layer.conf
```bitbake
# We have a conf and classes directory, add to BBPATH
BBPATH .= ":${LAYERDIR}"

# We have recipes-* directories, add to BBFILES
BBFILES +=  "${LAYERDIR}/recipes-*/*/*.bb"

BBFILE_COLLECTIONS += "tb-isar-dev"
BBFILE_PATTERN_tb-isar-dev = "^${LAYERDIR}/"
BBFILE_PRIORITY_tb-isar-dev = "5"

# This should only be incremented on significant changes that will
# cause compatibility issues with other layers
LAYERVERSION_tb-isar-dev = "1"
LAYERSERIES_COMPAT_tb-isar-dev = "v0.6"

LAYERDIR_tb-isar-dev = "${LAYERDIR}"
```
